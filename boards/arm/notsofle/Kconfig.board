## boards/arm/notsofle/Kconfig.board
```kconfig
#
# Copyright (c) 2024 The ZMK Contributors
# SPDX-License-Identifier: MIT
#

config BOARD_NOTSOFLE_LEFT
    bool "notsofle left"
    depends on SOC_NRF52840_QIAA

config BOARD_NOTSOFLE_RIGHT
    bool "notsofle right"
    depends on SOC_NRF52840_QIAA
```
